## Kconfig
```kconfig
# SPDX-License-Identifier: GPL-2.0
#
# For a description of the syntax of this configuration file,
# see Documentation/kbuild/kconfig-language.rst.
#
mainmenu "devtools/$(ARCH) Configuration"

comment "Compiler: $(CC_VERSION_TEXT)"

source "Kconfig.include"

source "common/Kconfig"

source "platform/Kconfig"
```

## the_build_system/Kconfig
```kconfig
# SPDX-License-Identifier: GPL-2.0
#
# For a description of the syntax of this configuration file,
# see Documentation/kbuild/kconfig-language.rst.
#
mainmenu "devtools/$(ARCH) Configuration"

comment "Compiler: $(CC_VERSION_TEXT)"

source "Kconfig.include"

source "Kconfig.x86"

source "../linux/Kconfig"

source "../macos/Kconfig"

source "../node/Kconfig"

source "../posix/Kconfig"

#source "config/default.conf"
```

## the_build_system/arch/Kconfig
```kconfig
config LINUX
	def_bool y
	select X86

config 64BIT
	bool "64-bit kernel" if "$(ARCH)" = "x86"
	default "$(ARCH)" != "i386"
	---help---
	Say yes for x86_64 (amd64) platform
	Say no for i386 platform

config X86
	def_bool y

config X86_64
	def_bool y
	depends on X86 && 64BIT

config X86_32
	def_bool y
	depends on X86 && !64BIT

config OUTPUT_FORMAT
	string
	default "elf32-i386" if X86_32
	default "elf64-x86-64" if X86_64
```
